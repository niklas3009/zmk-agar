## boards/arm/agar_mini/Kconfig.board
```kconfig
config BOARD_AGAR_MINI_LEFT
    bool "Agar Mini Left"
    depends on SOC_NRF52840_QIAA

config BOARD_AGAR_MINI_RIGHT
    bool "Agar Mini Right"
    depends on SOC_NRF52840_QIAA
```

## boards/arm/agar_mini/agar_mini_right_defconfig
```kconfig
CONFIG_SOC_SERIES_NRF52X=y
CONFIG_SOC_NRF52840_QIAA=y
CONFIG_BOARD_AGAR_MINI_RIGHT=y

# Bluetooth Name & Limits
CONFIG_ZMK_KEYBOARD_NAME="Agar Mini"
CONFIG_BT_DEVICE_NAME="Agar Mini"
CONFIG_BT_DEVICE_NAME_MAX=65

# Enable MPU
CONFIG_ARM_MPU=y

# Enable GPIO
CONFIG_GPIO=y

# Enable pinctrl
CONFIG_PINCTRL=y

# Place application at &code_partition address
CONFIG_USE_DT_CODE_PARTITION=y

# Generate a .uf2 firmware image
CONFIG_BUILD_OUTPUT_UF2=y

# Enable NVS for settings
CONFIG_MPU_ALLOW_FLASH_WRITE=y
CONFIG_NVS=y
CONFIG_SETTINGS_NVS=y
CONFIG_FLASH=y
CONFIG_FLASH_PAGE_LAYOUT=y
CONFIG_FLASH_MAP=y

# Enable ZMK BLE and USB output
CONFIG_ZMK_BLE=y
CONFIG_ZMK_USB=y
```
